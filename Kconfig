## Kconfig
```kconfig
menu "Architecture Settings"
choice
	prompt "Select Architecture"
	config ARCH_ARM
		bool "ARM"
		help
			ARM Based Architecture
	config ARCH_X86
		bool "X86"
		help
			X86 Based Architecture
endchoice
comment "Global Settings"
comment "Waring CPU Clock Hz not set!"
	depends on CPU_CLOCK_HZ=0
choice	
	prompt "Select CPU Clock Speed Source"
	config CPU_CLOCK_BY_DEFINE
		bool "CPU Clock Speed over Define"
		depends on !ARCH_X86
		help
			CPU Clock Speed is defined by Define s. CONFIG_CPU_CLOCK_HZ
	config CPU_CLOCK_BY_INTERFACE
		bool "CPU Clock Speed over Clock Interface"
		depends on !ARCH_X86
		help
			CPU Clock Speed is defined by Clock Interface over Function clock_getCPUSpeed
endchoice
config CPU_CLOCK_HZ
	int "CPU Clock Speed(Hz)"
	default 0
	depends on !ARCH_X86 && CPU_CLOCK_BY_DEFINE
	help
		CPU Clock Speed in Hz
comment "Architecture Settings"
if ARCH_ARM=y
source arch/arm/Kconfig
endif
if ARCH_X86=y
source arch/x86/Kconfig
endif
endmenu
```

## arm/Kconfig
```kconfig
choice
	depends on ARCH_ARM
	prompt "Select Core Type"
	config ARCH_ARM_CORTEX_M0
		bool "ARM Cortex-M0"
		help
			ARM Cortex-M0
	config ARCH_ARM_CORTEX_M3
		bool "ARM Cortex-M3/M4"
		help
			ARM Cortex-M3/M4
	config ARCH_ARM_CORTEX_M4F
		bool "ARM Cortex-M4F"
		help
			ARM Cortex-M4F
endchoice
config ARCH_JUMP_ADDR_ODD
	bool
	depends on ARCH_ARM_CORTEX_M0 || ARCH_ARM_CORTEX_M3 || ARCH_ARM_CORTEX_M4F
	default y
config ARCH_ARM_ERRATA_709718
	bool "Fix ARM Errata 709718: VDIV or VSQRT instructions might not complete correctly when very short ISRs are used"
	depends on ARCH_ARM_CORTEX_M4F
	default y
	help
		Arm Errata 709718: VDIV or VSQRT instructions might not complete correctly when very short
		ISRs are used
		Affects: Cortex-M4F
		Fault Type: Programmer Category B
		Fault Status: Present in: r0p0, r0p1 Open.
		On Cortex-M4 with FPU, the VDIV and VSQRT instructions take 14 cycles to execute. When
		an interrupt is taken a VDIV or VSQRT instruction is not terminated, and completes its
		execution while the interrupt stacking occurs. If lazy context save of floating point state is
		enabled then the automatic stacking of the floating point context does not occur until a floating
		point instruction is executed inside the interrupt service routine.
		Lazy context save is enabled by default. When it is enabled, the minimum time for the first
		instruction in the interrupt service routine to start executing is 12 cycles. In certain timing
		conditions, and if there is only one or two instructions inside the interrupt service routine, then
		the VDIV or VSQRT instruction might not write its result to the register bank or to the FPSCR.
		Workaround: A workaround is only required if the floating point unit is present and enabled. A workaround is
		not required if the memory system inserts one or more wait states to every stack transaction.
		There are two workarounds:
		1) Disable lazy context save of floating point state by clearing LSPEN to 0 (bit 30 of the
		FPCCR at address 0xE000EF34).

		2) Ensure that every interrupt service routine contains more than 2 instructions in addition to
		the exception return instruction.

config ARCH_ARM_FAULT_HANDLER
	bool
	depends on MACH_USE_GENERIC_FAULT_HANDLER
	depends on ARCH_ARM_CORTEX_M0=y || ARCH_ARM_CORTEX_M3=y || ARCH_ARM_CORTEX_M4F=y

	default y
config ARCH_ARM_PRINT_ERROR
	bool "Print error to Console"
	depends on ARCH_ARM_FAULT_HANDLER
	default n
config ARCH_SUPPORT_UNWIND_TABLES
	bool
	depends on NEWLIB
	default y
config ARCH_SUPPORT_CUSTOM_TASK_RETURN_ADDRESS
	bool
	default y
if ARCH_ARM_CORTEX_M0=y
source arch/arm/cortex-m0/Kconfig
endif
if ARCH_ARM_CORTEX_M3=y
source arch/arm/cortex-m3/Kconfig
endif
if ARCH_ARM_CORTEX_M4F=y
source arch/arm/cortex-m4f/Kconfig
endif
source arch/arm/debug/Kconfig
```

## arm/cortex-m0/Kconfig
```kconfig
comment "Cortex-M0 Settings"
config ARCH_INCLUDE
	string 
	default "-Iarch/arm/cortex-m0 -Iarch/arm/include"
config ARCH_CFLAGS
	string
	default "-mthumb -mcpu=cortex-m0 -march=armv6-m -mtune=cortex-m0"
config ARCH_AFLAGS
	string
	default "-mthumb -mcpu=cortex-m0 -march=armv6-m -mtune=cortex-m0"
config ARCH_LDFLAGS
	string
	default ""
config ARCH_HAS_TICKLESS_SUPPORT
	bool
	default y
```

## arm/cortex-m3/Kconfig
```kconfig
comment "Cortex-M3 Settings"
config ARCH_INCLUDE
	string 
	default "-Iarch/arm/cortex-m3 -Iarch/arm/include"
config ARCH_CFLAGS
	string
	default "-mthumb -mcpu=cortex-m3"
config ARCH_LDFLAGS
	string
	default ""
config PORT_HAS_OPTIMISED_TASK_SELECTION
	bool
	default y
```

## arm/cortex-m4/Kconfig
```kconfig
comment "Cortex-M4 Settings"
config ARCH_INCLUDE
	string 
	default "-Iarch/arm/cortex-m4 -Iarch/arm/include"
config ARCH_CFLAGS
	string
	default "-mcpu=cortex-m4 -mthumb -mfpu=fpv4-sp-d16 -mfloat-abi=hard"
config ARCH_AFLAGS
	string 
	default "-mcpu=cortex-m4 -mthumb -mfpu=fpv4-sp-d16 -mfloat-abi=hard"
config ARCH_LDFLAGS
	string
	default ""
config PORT_HAS_OPTIMISED_TASK_SELECTION
	bool
	default y
```

## arm/debug/Kconfig
```kconfig
menuconfig ARCH_ARM_DEBUG
	bool "ARM Debug"
	depends on ARCH_ARM_CORTEX_M0 || ARCH_ARM_CORTEX_M3 || ARCH_ARM_CORTEX_M4F
	depends on UART
if ARCH_ARM_DEBUG=y
config SEMIHOSTING
	bool "Semihosting"
	default n
	config SEMIHOSTING_UART
		bool "Semihosting UART"
		depends on  SEMIHOSTING
		default y
		help
			Semihosting UART Support
endif
```

## avr/Kconfig
```kconfig
comment "AVR Settings"
config ARCH_INCLUDE
	string 
	default "-Iarch/avr"
config ARCH_CFLAGS
	string
	default ""
config ARCH_AFLAGS
	string
	default ""
config ARCH_LDFLAGS
	string
	default ""
```

## c2000/Kconfig
```kconfig
choice
	prompt "Select Core Type"
	config ARCH_C2000_C28x
		bool "TI C2000 C28x DSP"
		help
			TI C2000 C28x DSP

endchoice
if ARCH_C2000_C28x=y
source arch/c2000/c28x/Kconfig
endif
```

## c2000/c28x/Kconfig
```kconfig
comment "C2000 C28x DSP Settings"
config ARCH_INCLUDE
	string
	default "-Iarch/c2000/c28x -Iarch/c2000/include -I$(shell dirname $(shell which $(CC)))/../include"
config ARCH_CFLAGS
	string
	default ""
config ARCH_AFLAGS
	string
	default ""
config ARCH_LDFLAGS
	string
	default ""
```

## framaC/Kconfig
```kconfig
comment "FramaC Settings"
config ARCH_INCLUDE
	string 
	default "-I arch/framaC"
config ARCH_CFLAGS
	string
	default ""
config ARCH_AFLAGS
	string 
	default ""
config ARCH_LDFLAGS
	string
	default ""
config ARCH_HAS_OPTIMISED_TASK_SELECTION
	bool
	default y
config ARCH_HAS_TICKLESS_SUPPORT
	bool
	default y
```

## riscv/Kconfig
```kconfig
# Slected by Mach
choice
	prompt "Select Mode"
	config ARCH_RISCV_MMODE
		bool "Machine-mode only"
	# No Port Available  
	config ARCH_RISCV_SMODE
		bool "Supervisor-mode / User-mode"
endchoice
if ARCH_RISCV_MMODE=y
source arch/riscv/mmode/Kconfig 
endif
if ARCH_RISCV_SMODE=y
source arch/riscv/smode/Kconfig 
endif

choice
	prompt "Memmory Model"
	config ARCH_RISCV_MEMMORY_MEDLOW
		bool "Medlow"
		depends on !ARCH_64BIT
		help
			GCC Docu:

			"Generate code for the medium-low code model. The program and its statically defined symbols must lie within a
			single 2 GiB address range and must lie between absolute addresses -2 GiB and +2 GiB. Programs can be statically
			or dynamically linked. This is the default code model."

	config ARCH_RISCV_MEMMORY_MEDANY
		bool "medany"
		help
			GCC Docu:

			"Generate code for the medium-any code model. The program and its statically defined symbols must be within any
			single 2 GiB address range. Programs can be statically or dynamically linked."
endchoice

if ARCH_RISCV_MEMMORY_MEDANY=y
config ARCH_CFLAGS
	string
	default "-mcmodel=medany"
config ARCH_AFLAGS
	string 
	default "-mcmodel=medany"
endif
if ARCH_RISCV_MEMMORY_MEDLOW=y
config ARCH_CFLAGS
	string
	default "-mcmodel=medlow"
config ARCH_AFLAGS
	string 
	default "-mcmodel=medlow"
endif

config ARCH_LDFLAGS
	string
	default ""

config EXTRA_ARCH_LINKFLAGS
	string
	default "-nostartfiles"

config ARCH_HAS_OPTIMISED_TASK_SELECTION
	bool
	default y

config ARCH_RISCV_PLIC
	bool
	depends on MACH_HAS_PLIC
	default y

config ARCH_RISCV_HAS_MTIME
	bool
	depends on MACH_HAS_MTIME
	depends on ARCH_RISCV_MMODE
	default y

config ARCH_RISCV_SEP_IRQ_STACK
	bool "Separated IRQ Stack"
	default n
	help
		Separated IRQ Stack if not defined Main Stack is used
	config ARCH_RISCV_ISR_STACK_SIZE_WORDS
		int "ISR STACK SIZE WORDS"
		depends on ARCH_RISCV_SEP_IRQ_STACK
		default 500
config ARCH_RISCV_HAS_CLINT
	bool
	default y
	depends on MACH_HAS_CLINT

config INCLUDE_ARCH_FREEROTS_CONFIG
	bool
	default y

config ARCH_RISCV_INIT
	bool
	default y
	depends on MACH_NEED_RISCV_INIT

config ARCH_RISCV_SYSINIT
	bool
	default y
	depends on MACH_NEED_GENERIC_SYSINIT

config ARCH_RISCV_HARDWARE_FLOAD
	bool
	default y
	depends on MACH_NEED_RISCV_HARDWARE_FLOAD

config ARCH_ID
	int "Primare HartID"
	default 0

config ARCH_BOOT_UNDER_UBOOT
	bool "Boot under UBooot"
	depends on ARCH_RISCV_SMODE
	default n
	help
		All CPU are Booted under U-Boot so wie must jump to secondary

config ARCH_SBI
	bool "SBI Interface"
	default y
	depends on ARCH_RISCV_SMODE
	config ARCH_SBI_TIMER
		bool "SBI Timer"
		default y
		depends on ARCH_SBI
	config ARCH_SBI_UART
		bool "SBI UART"
		default y
		depends on ARCH_SBI
		depends on UART
```

## x86/Kconfig
```kconfig
choice
	depends on ARCH_X86
	prompt "Select Core Type"
	config ARCH_X86_LINUX
		bool "X86 Linux Emulator"
		help
			X86 Linux Emulator
endchoice
if ARCH_X86_LINUX
source arch/x86/linux/Kconfig
endif
```

## x86/linux/Kconfig
```kconfig
comment "Linux Emulator Settings"
config ARCH_INCLUDE
	string 
	default "-Iarch/x86/linux"
config ARCH_CFLAGS
	string
	default ""
config ARCH_AFLAGS
	string 
	default ""
config ARCH_LDFLAGS
	string
	default ""
#config ARCH_HAS_OPTIMISED_TASK_SELECTION
#	bool
#	default y
#config ARCH_HAS_TICKLESS_SUPPORT
#	bool
#	default y
```
